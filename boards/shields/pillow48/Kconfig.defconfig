## boards/shields/pillow48/Kconfig.defconfig
```kconfig
if SHIELD_PILLOW48_LEFT

config ZMK_KEYBOARD_NAME
    default "pillow48_left"

config ZMK_SPLIT_ROLE_CENTRAL
    default y

endif

if SHIELD_PILLOW48_LEFT || SHIELD_PILLOW48_RIGHT

config ZMK_SPLIT
    default y

endif
```

## boards/shields/pillow48/Kconfig.shield
```kconfig
config SHIELD_PILLOW48_LEFT
    def_bool $(shields_list_contains,pillow48_left)

config SHIELD_PILLOW48_RIGHT
    def_bool $(shields_list_contains,pillow48_right)

config SHIELD_PILLOW48_DONGLE
    def_bool $(shields_list_contains,pillow48_dongle)
```

## config/west.yml
```yaml
manifest:
  remotes:
    - name: zmkfirmware
      url-base: https://github.com/zmkfirmware
  projects:
    - name: zmk
      remote: zmkfirmware
      revision: v0.3
      import: app/west.yml
  self:
    path: zmk-config-pillow48



# manifest:
#   remotes:
#     - name: zmkfirmware
#       url-base: https://github.com/zmkfirmware
#   projects:
#     - name: zmk
#       remote: zmkfirmware
#       revision: main
#       import: app/west.yml
#   self:
#     path: zmk-config-pillow48
```
